#include <Adafruit_Fingerprint.h>

// Serial3		==> Tx (White) = 14		==> Rx (Green) = 15
Adafruit_Fingerprint finger = Adafruit_Fingerprint(&Serial3);

int p;

void setup()  
{ 
  while(!Serial);
  Serial.begin(115200);
  Serial.println("\n[ Upload + Store FlashMemory + Show Templete ]\n");

  // set the data rate for the sensor serial port
  // HIGH baudrate must use Hardware Serial (Serial3 / Serial2 / Serial1)
  finger.begin(115200);
  
  if (finger.verifyPassword()) {
    Serial.println("Found fingerprint sensor!");
  } else {
    Serial.println("Did not find fingerprint sensor :(");
    while (1);
  }
      
uint8_t packet2[] = {0x03, 0x01, 0x5E, 0x21, 0x89, 0x00, 0x00, 0x00, 0x00, 0x00, 0x00, 0x00, 0x00,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 0x9A, 0x9F};
uint8_t packet3[] = {0x08, 0xAC, 0x8C, 0x9F, 0x16, 0x2D, 0x4B, 0xFF, 0x58, 0x2E, 0x1D, 0x9F, 0x1F,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 0x00, 0x00};
uint8_t packet4[] = {0x03, 0x01, 0x5B, 0x2C, 0x86, 0x00, 0x00, 0x00, 0x00, 0x00, 0x00, 0x00, 0x00,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 0x51, 0xBF};
uint8_t packet5[] = {0x4A, 0x31, 0x5A, 0x9F, 0x1A, 0x33, 0xCB, 0xDF, 0x0B, 0xB4, 0x0C, 0x3F, 0x59,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 0x00, 0x00};
	
	Serial.print("\n===> Write Packet");
   p = finger.uploadModelPercobaan(packet2, packet3, packet4, packet5);		// Simpan di Char Buffer 01      
  switch (p) {
    case FINGERPRINT_OK:
      Serial.println(" SUKSES");
      Serial.read();
      break;
    case FINGERPRINT_PACKETRECIEVEERR:
      Serial.println("Communication error");
      return p;
    case FINGERPRINT_BADPACKET:
      Serial.println("Bad packet");
      return p;      
    default:
	{
	Serial.println("\n==>[SUKSES] UploadModel = ");
      //return p;
	}
  }
  int id = 12;		// --> id = FlashMemory Place
  Serial.print("\n==>[SUKSES] StoreModel + ID = ");Serial.print(id);
  p = finger.storeModel(id);									// taruh di ID = 0 pada flash memory FP
  if (p == FINGERPRINT_OK) {
    Serial.println(" Stored!");
  } else if (p == FINGERPRINT_PACKETRECIEVEERR) {
    Serial.println("Communication error");
    return p;
  } else if (p == FINGERPRINT_BADLOCATION) {
    Serial.println("Could not store in that location");
    return p;
  } else if (p == FINGERPRINT_FLASHERR) {
    Serial.println("Error writing to flash");
    return p;
  } else {
    Serial.println("Unknown error");
    return p;
  }
}

void loop()
{}


